// SPDX-License-Identifier: GPL-2.0-only
/*
 * Copyright (c) 2018-2019, The Linux Foundation. All rights reserved.
 */

#include "../lito-winglm_common/lito-winglm_common-touch.dtsi"

&qupv3_se7_i2c {
	#address-cells = <1>;
	#size-cells = <0>;

	status = "ok";

	sw42902@28 {
		status = "ok";
	};
};

&qupv3_se0_i2c {
	#address-cells = <1>;
	#size-cells = <0>;

	status = "ok";

	sw42902_sub@29 {
		status = "ok";
	};
};

